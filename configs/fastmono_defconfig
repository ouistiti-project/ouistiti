## packages/buildroot/Config.in
```kconfig
source "$BR2_EXTERNAL_OUISTITI_PATH/package/ouistiti/Config.in"
source "$BR2_EXTERNAL_OUISTITI_PATH/package/ouilogin/Config.in"
source "$BR2_EXTERNAL_OUISTITI_PATH/package/ouicloud/Config.in"
```

## packages/buildroot/libhttpserver/Config.in
```kconfig
config BR2_PACKAGE_LIBHTTPSERVER
	bool
	help
	  small, fast and secure http library.

	  https://github.com/ouistiti-net

if BR2_PACKAGE_LIBHTTPSERVER

config BR2_PACKAGE_LIBHTTPSERVER_MBEDTLS
	bool "ssl support with mbedtls"
	select BR2_PACKAGE_MBEDTLS
	help
	  Enable SSL/TLS support for ouistiti.

config BR2_PACKAGE_LIBHTTPSERVER_WEBSOCKET
	bool "websocket gateway support"
	help
	  Enable Websocket support for ouistiti.

endif
```

## packages/buildroot/ouistiti/Config.in
```kconfig
config BR2_PACKAGE_OUISTITI
	bool "ouistiti: Embedded webserver and websocket gateway"
	depends on BR2_USE_MMU
	select BR2_PACKAGE_LIBCONFIG
	select BR2_PACKAGE_LIBHTTPSERVER
	help
	  ouistiti small, fast and secure webserver.
	  It is dedicated to configure and manage embedded devices.

	  https://github.com/ouistiti-project

if BR2_PACKAGE_OUISTITI

config BR2_PACKAGE_OUISTITI_AUTH
	bool "authentication support"
	help
	  Enable Basic/Digest support for ouistiti.

config BR2_PACKAGE_OUISTITI_AUTH_SQLITE
	bool "auth: sqlite db storage"
	depends on BR2_PACKAGE_OUISTITI_AUTH
	select BR2_PACKAGE_SQLITE
	help
	  Enable password storage into sqlite DB.
endif

if BR2_PACKAGE_LIBHTTPSERVER_WEBSOCKET
config BR2_PACKAGE_OUISTITI_WS_JSONRPC
	bool "websocket: jsonrpc server"
	depends on BR2_PACKAGE_LIBHTTPSERVER_WEBSOCKET
	select BR2_PACKAGE_JANSSON
	help
	  Add a jsonrpc server for websocket.

config BR2_PACKAGE_OUISTITI_WS_CHAT
	bool "websocket: chat server"
	depends on BR2_PACKAGE_LIBHTTPSERVER_WEBSOCKET
	help
	  Add a jsonrpc server for websocket.
endif
```

## packages/buildroot/package/libouistiti/Config.in
```kconfig
menuconfig BR2_PACKAGE_LIBOUISTITI
	bool "libouistiti"
	help
	  small, fast and secure http library.

	  https://github.com/ouistiti-project


config BR2_PACKAGE_LIBOUISTITI_CLIENT
	bool "HTTP client parsing"
	depends on BR2_PACKAGE_LIBOUISTITI
	help
	  Allow to generate Request and parse Response.

choice
	prompt "hash library frontend for ouistiti"
	depends on BR2_PACKAGE_LIBOUISTITI
	help
	  Hash frontend for ouistiti.

config BR2_PACKAGE_LIBOUISTITI_MBEDTLS
	bool "mbedtls"
	depends on BR2_PACKAGE_MBEDTLS

config BR2_PACKAGE_LIBOUISTITI_OPENSSL
	bool "openssl (experimental)"
	depends on BR2_PACKAGE_OPENSSL

config BR2_PACKAGE_LIBOUISTITI_WOLFSSL
	bool "wolfssl (experimental)"
	depends on BR2_PACKAGE_WOLFSSL

endchoice

config BR2_PACKAGE_LIBOUISTITI_WEBSOCKET
	bool "websocket protocol library"
	depends on BR2_PACKAGE_LIBOUISTITI
	help
	  Enable Websocket support for ouistiti.
```

## packages/buildroot/package/ouicloud/Config.in
```kconfig
config BR2_PACKAGE_OUICLOUD
	bool "ouicloud"
	depends on BR2_PACKAGE_OUISTITI
	help
	  file sharing website for ouistiti

	  https://github.com/ouistiti-project
```

## packages/buildroot/package/ouilogin/Config.in
```kconfig
config BR2_PACKAGE_OUILOGIN
	bool "ouilogin"
	depends on BR2_PACKAGE_OUISTITI
	help
	  authenticator website for ouistiti

	  https://github.com/ouistiti-project
```

## packages/buildroot/package/ouistiti/Config.in
```kconfig
menuconfig BR2_PACKAGE_OUISTITI
	bool "ouistiti: Embedded webserver and websocket gateway"
	depends on BR2_USE_MMU
	select BR2_PACKAGE_LIBCONFIG
	help
	  ouistiti small, fast and secure webserver.
	  It is dedicated to configure and manage embedded devices.

	  https://github.com/ouistiti-project

choice
	prompt "SSL/TLS library support"
	depends on BR2_PACKAGE_OUISTITI
	default BR2_PACKAGE_OUISTITI_MBEDTLS
	help
	  module to manage HTTPS request.

config BR2_PACKAGE_OUISTITI_MBEDTLS
	bool "mbedtls"
	depends on BR2_PACKAGE_OUISTITI
	depends on BR2_PACKAGE_MBEDTLS
	select BR2_PACKAGE_LIBOUISTITI_MBEDTLS

comment "mbedtls"
	depends on BR2_PACKAGE_OUISTITI
	depends on !BR2_PACKAGE_MBEDTLS

config BR2_PACKAGE_OUISTITI_OPENSSL
	bool "openssl (experimental)"
	depends on BR2_PACKAGE_OUISTITI
	depends on BR2_PACKAGE_OPENSSL
	select BR2_PACKAGE_LIBOUISTITI_OPENSSL

comment "openssl (experimental)"
	depends on BR2_PACKAGE_OUISTITI
	depends on !BR2_PACKAGE_OPENSSL

config BR2_PACKAGE_OUISTITI_WOLFSSL
	bool "wolfssl (experimental)"
	depends on BR2_PACKAGE_OUISTITI
	depends on BR2_PACKAGE_WOLFSSL
	select BR2_PACKAGE_LIBOUISTITI_WOLFSSL

comment "wolfssl (experimental)"
	depends on BR2_PACKAGE_OUISTITI
	depends on !BR2_PACKAGE_WOLFSSL

endchoice

menuconfig BR2_PACKAGE_OUISTITI_AUTH
	bool "authentication support"
	depends on BR2_PACKAGE_OUISTITI
	default y
	help
	  Enable Basic/Digest/Bearer... support for ouistiti.

config BR2_PACKAGE_OUISTITI_AUTH_SQLITE
	bool "sqlite db storage"
	select BR2_PACKAGE_SQLITE
	depends on BR2_PACKAGE_OUISTITI_AUTH
	help
	  Enable password storage into sqlite DB.

config BR2_PACKAGE_OUISTITI_AUTH_UNIX
	bool "unix shadow file"
	select BR2_PACKAGE_OUISTITI_AUTH_BASIC
	depends on BR2_PACKAGE_OUISTITI_AUTH
	help
	  Enable password storage from UNIX password system.

config BR2_PACKAGE_OUISTITI_AUTH_TOKEN
	bool "Token exchange"
	depends on BR2_PACKAGE_OUISTITI_AUTH
	help
	  generate token after authentication and
	  use this token for the following request

config BR2_PACKAGE_OUISTITI_AUTH_JWT
	bool "auth: Json Web Token"
	depends on BR2_PACKAGE_JANSSON
	depends on BR2_PACKAGE_OUISTITI_AUTH_TOKEN
	depends on BR2_PACKAGE_OUISTITI_AUTH
	help
	  Generate and parse JsonWebToken for authenticate.

comment "JWT support: enable Jansson library"
	depends on BR2_PACKAGE_OUISTITI_AUTH
	depends on !BR2_PACKAGE_JANSSON

config BR2_PACKAGE_OUISTITI_AUTH_TOTP
	bool "auth: Timed based One Time Password"
	depends on BR2_PACKAGE_OUISTITI_AUTH
	help
	  Check a totp password depending on the user name

config BR2_PACKAGE_OUISTITI_AUTH_BASIC
	bool "auth: Basic authentication"
	depends on BR2_PACKAGE_OUISTITI_AUTH
	help
	  Basic Authentication RFC

config BR2_PACKAGE_OUISTITI_AUTH_DIGEST
	bool "auth: Digest authentication"
	depends on BR2_PACKAGE_OUISTITI_AUTH
	help
	  Digest Authentication RFC

config BR2_PACKAGE_OUISTITI_AUTH_BEARER
	bool "auth: Bearer authentication"
	depends on BR2_PACKAGE_OUISTITI_AUTH
	help
	  Bearer Authentication RFC

config BR2_PACKAGE_OUISTITI_AUTH_OAUTH2
	bool "auth: oAuth2 authentication"
	depends on BR2_PACKAGE_OUISTITI_AUTH_JWT
	depends on BR2_PACKAGE_LIBOUISTITI_CLIENT
	depends on BR2_PACKAGE_OUISTITI_AUTH
	help
	  oAuth2 Authentication RFC

comment "oAuth2 authentication: enable Auth JWT"
	depends on BR2_PACKAGE_OUISTITI_AUTH
	depends on !BR2_PACKAGE_OUISTITI_AUTH_JWT

config BR2_PACKAGE_OUISTITI_AUTH_WWWFORM
	bool "auth: POST www-form-urlencoded authentication"
	depends on BR2_PACKAGE_OUISTITI_AUTH
	help
	  Check username password from a POST request
	  with username and query inside the query.

config BR2_PACKAGE_OUISTITI_USERFILTER
	bool "Users filter"
	depends on BR2_PACKAGE_OUISTITI
	select BR2_PACKAGE_SQLITE
	default n

menuconfig BR2_PACKAGE_OUISTITI_DOCUMENT
	bool "Document server"
	depends on BR2_PACKAGE_OUISTITI
	default y

config BR2_PACKAGE_OUISTITI_DOCUMENT_REST
	bool "Enable REST API"
	depends on BR2_PACKAGE_OUISTITI_DOCUMENT
	help
	  upload/modify/delete files on host

config BR2_PACKAGE_OUISTITI_DOCUMENT_RANGE
	bool "Enable partial download"
	depends on BR2_PACKAGE_OUISTITI_DOCUMENT
	help
	  manage Range Header for partial document download

config BR2_PACKAGE_OUISTITI_DOCUMENT_HOME
	bool "Home directory"
	depends on BR2_PACKAGE_OUISTITI_AUTH
	depends on BR2_PACKAGE_OUISTITI_DOCUMENT
	help
	  Allows to manage files in HOME directory, following the
	  authentication

config BR2_PACKAGE_OUISTITI_CGI
	bool "CGI server"
	depends on BR2_PACKAGE_OUISTITI
	default n
	help
	  execute scripts over Common Gateway Interface

menuconfig BR2_PACKAGE_OUISTITI_WEBSOCKET
	bool "websocket support"
	default y
	depends on BR2_PACKAGE_OUISTITI
	select BR2_PACKAGE_LIBOUISTITI_WEBSOCKET
	help
	  create a proxy for UNIX socket to communicate on Websocket

config BR2_PACKAGE_OUISTITI_WS_JSONRPC
	bool "websocket: jsonrpc server"
	select BR2_PACKAGE_JANSSON
	depends on BR2_PACKAGE_OUISTITI_WEBSOCKET
	help
	  Add a jsonrpc server for websocket.
	  A system of plugin allows to manipulate:
	    - sql database
	    - authentication database from the module

config BR2_PACKAGE_OUISTITI_WS_CHAT
	bool "websocket: chat server"
	depends on BR2_PACKAGE_OUISTITI_WEBSOCKET
	help
	  Add a simple chat server for websocket.

config BR2_PACKAGE_OUISTITI_WEBSTREAM
	bool "webstream support (experimental)"
	depends on BR2_PACKAGE_OUISTITI
	default n
	help
	  create a proxy for UNIX socket to send data

config BR2_PACKAGE_OUISTITI_WS_MJPEG
	bool "webstream: mjpeg server"
	depends on BR2_PACKAGE_OUISTITI_WEBSTREAM
	help
	  Add a mjpeg streamer from a webcam.
	  The server use V4L2 to manage the camera.

config BR2_PACKAGE_OUISTITI_WEBCOMMON
	bool "website framework"
	depends on BR2_PACKAGE_OUISTITI
	help
	  install js scripts css and index.html
```
